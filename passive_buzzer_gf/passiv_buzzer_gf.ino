int buzzer_pin = 6;

// 할아버지의 낡은 시계 음계
int melody[] = 
    // 523,587,659,698,784,880,988,1046
    {392,
    523,494,523,587,523,587,
    659,698,659,440,587,587,
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    523,494,
    523};

int melody_duration[] = 
    {4,
    4,8,8,4,8,8,
    4,8,8,4,8,8,
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    2,2,
    3}; 

void setup(){
    pinMode(buzzer_pin,OUTPUT);
}

int between;

void loop(){
    for(int i=0;i<sizeof(melody)/sizeof(int);i++){
        int duration = 1000 / melody_duration[i];
        tone(buzzer_pin,melody[i],duration);
        if(i==64 || i==65 || i==76){
            between = 300 + duration * 1.25;;
        }
        else if (i==101 || i==102){
            between = 450 + duration * 1.25;
        }
        else if(i==85 || i==86 || i==87 || i==96 || i==97 || i==98){
            between = 150 + duration * 1.25;
        }
        else{
            between = duration * 1.25;
        }
        
        delay(between);
        noTone(buzzer_pin);
    }
}